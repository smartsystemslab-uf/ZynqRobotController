## FPGA/Zynq_Robot_Controller_v2/Petalinux/project-spec/meta-plnx-generated/conf/machine/plnx-zynq7.conf
```bitbake
require conf/machine/include/tune-zynq.inc
require conf/machine/include/machine-xilinx-overrides.inc
require conf/machine/include/machine-xilinx-default.inc
require conf/machine/include/machine-xilinx-board.inc

SERIAL_CONSOLES_CHECK = "${SERIAL_CONSOLES}"
MACHINE_FEATURES = "rtc ext2 ext3 vfat usbhost"
```
